## Documentation/devicetree/bindings/i2c/aspeed,i2c.yaml
```yaml
# SPDX-License-Identifier: (GPL-2.0-only OR BSD-2-Clause)
%YAML 1.2
---
$id: http://devicetree.org/schemas/i2c/aspeed,i2c.yaml#
$schema: http://devicetree.org/meta-schemas/core.yaml#

title: ASPEED I2C on the AST24XX, AST25XX, and AST26XX SoCs Device Tree Bindings

maintainers:
  - Rayn Chen <rayn_chen@aspeedtech.com>

allOf:
  - $ref: /schemas/i2c/i2c-controller.yaml#

properties:
  compatible:
    enum:
      - aspeed,ast2400-i2c-bus
      - aspeed,ast2500-i2c-bus
      - aspeed,ast2600-i2c-bus

  reg:
    minItems: 1
    items:
      - description: address offset and range of bus
      - description: address offset and range of bus buffer

  interrupts:
    maxItems: 1

  clocks:
    maxItems: 1
    description:
      root clock of bus, should reference the APB
      clock in the second cell

  resets:
    maxItems: 1

  bus-frequency:
    minimum: 500
    maximum: 4000000
    default: 100000
    description: frequency of the bus clock in Hz defaults to 100 kHz when not
      specified

  multi-master:
    type: boolean
    description:
      states that there is another master active on this bus

  bus-timeout-ms:
    default: 1000
    description:
      bus timeout in milliseconds defaults to 1 second when not specified

  #retries:
    description:
      Number of retries for master transfer

  aspeed,dma-buf-size:
    $ref: /schemas/types.yaml#/definitions/uint32
    description:
      size of DMA buffer (from 2 to 4095 in case of AST2500)
        Only AST2500/2600 support DMA mode.
        Limitations on AST2500 - I2C is sharing the DMA H/W with UHCI host
        controller and MCTP controller. Since those controllers operate with DMA
        mode only, I2C has to use buffer mode or byte mode instead if one of
        those controllers is enabled. Also make sure that if SD/eMMC or Port80
        snoop uses DMA mode instead of PIO or FIFO respectively, I2C can't use
        DMA mode. IF both DMA and buffer modes are enabled, DMA mode will be
        selected.

required:
  - reg
  - compatible
  - clocks
  - resets

unevaluatedProperties: false

examples:
  - |
    #include <dt-bindings/clock/aspeed-clock.h>
    i2c0: i2c-bus@40 {
      #address-cells = <1>;
      #size-cells = <0>;
      #interrupt-cells = <1>;
      compatible = "aspeed,ast2500-i2c-bus";
      reg = <0x40 0x40>;
      clocks = <&syscon ASPEED_CLK_APB>;
      resets = <&syscon ASPEED_RESET_I2C>;
      bus-frequency = <100000>;
      interrupts = <0>;
      interrupt-parent = <&i2c_ic>;
    };
```

## Documentation/devicetree/bindings/i2c/i2c-aspeed.txt
```
Device tree configuration for the I2C busses on the AST24XX, AST25XX, and AST26XX SoCs.

Required Properties:
- #address-cells	: should be 1
- #size-cells		: should be 0
- reg			: Address offset and range of bus registers.
			  An additional SRAM buffer address offset and range is
			  optional in case of enabling I2C dedicated SRAM for
			  buffer mode transfer support.
- compatible		: should be "aspeed,ast2400-i2c-bus"
			  or "aspeed,ast2500-i2c-bus"
			  or "aspeed,ast2600-i2c-bus"
- clocks		: root clock of bus, should reference the APB
			  clock in the second cell
- resets		: phandle to reset controller with the reset number in
			  the second cell
- interrupts		: interrupt number

Optional Properties:
- bus-frequency	: frequency of the bus clock in Hz defaults to 100 kHz when not
		  specified
- multi-master	: states that there is another master active on this bus.
- bus-timeout-ms: bus timeout in milliseconds defaults to 1 second when not
		  specified.
- #retries	: Number of retries for master transfer.

Example:

i2c {
	compatible = "simple-bus";
	#address-cells = <1>;
	#size-cells = <1>;
	ranges = <0 0x1e78a000 0x1000>;

	i2c_gr: i2c-global-regs@0 {
		compatible = "aspeed,ast2500-i2c-gr", "syscon";
		reg = <0x0 0x40>;

		#address-cells = <1>;
		#size-cells = <1>;
		ranges = <0x0 0x0 0x40>;

		i2c_ic: interrupt-controller@0 {
			#interrupt-cells = <1>;
			compatible = "aspeed,ast2500-i2c-ic";
			reg = <0x0 0x4>;
			interrupts = <12>;
			interrupt-controller;
		};
	};

	i2c0: i2c-bus@40 {
		#address-cells = <1>;
		#size-cells = <0>;
		#interrupt-cells = <1>;
		reg = <0x40 0x40>;
		compatible = "aspeed,ast2500-i2c-bus";
		clocks = <&syscon ASPEED_CLK_APB>;
		resets = <&syscon ASPEED_RESET_I2C>;
		bus-frequency = <100000>;
		interrupts = <0>;
		interrupt-parent = <&i2c_ic>;
	};

	/* buffer mode transfer enabled */
	i2c1: i2c-bus@80 {
		#address-cells = <1>;
		#size-cells = <0>;
		#interrupt-cells = <1>;
		reg = <0x80 0x40>, <0x210 0x10>;
		compatible = "aspeed,ast2500-i2c-bus";
		clocks = <&syscon ASPEED_CLK_APB>;
		resets = <&syscon ASPEED_RESET_I2C>;
		bus-frequency = <100000>;
		interrupts = <1>;
		interrupt-parent = <&i2c_ic>;
	};
};
```

## Documentation/devicetree/bindings/i3c/snps,dw-i3c-master.txt
```
Bindings for Synopsys DesignWare I3C master block
=================================================

Required properties:
--------------------
- compatible: shall be "snps,dw-i3c-master-1.00a"
- clocks: shall reference the core_clk
- interrupts: the interrupt line connected to this I3C master
- reg: Offset and length of I3C master registers

Mandatory properties defined by the generic binding (see
Documentation/devicetree/bindings/i3c/i3c.yaml for more details):

- #address-cells: shall be set to 3
- #size-cells: shall be set to 0

Optional properties defined by the generic binding (see
Documentation/devicetree/bindings/i3c/i3c.yaml for more details):

- i2c-scl-hz
- i3c-scl-hz

Optional properties specific for this driver:

- i3c-od-scl-low-ns: SCL low period for Open-Drain phase. Expressed in
       nanoseconds. It is validated by the driver. Minimum value is 200.
- i3c-od-scl-high-ns: SCL high period for Open-Drain phase. Expressed in
       nanoseconds. It is validated by the driver. Minimum value is 25.
- i3c-pp-scl-low-ns: SCL low period for Push-Pull phase. Expressed in
       nanoseconds. It is validated by the driver. Minimum value is 25.
- i3c-pp-scl-high-ns: SCL high period for Push-Pull phase. It is expressed in
       nanoseconds. It is validated by the driver. Minimum value is 25.
- sda-tx-hold-ns: SDA Hold Time (Thd_dat). Expressed in nanoseconds. It is not
       validated by driver. Minimum value is 5. Maximum value is 35. Other
	   values will be trimmed to the range. This parameter is not supported by
	   old IP versions.

I3C device connected on the bus follow the generic description (see
Documentation/devicetree/bindings/i3c/i3c.yaml for more details).

Example:

	i3c-master@2000 {
		compatible = "snps,dw-i3c-master-1.00a";
		#address-cells = <3>;
		#size-cells = <0>;
		reg = <0x02000 0x1000>;
		interrupts = <0>;
		clocks = <&i3cclk>;

		eeprom@57{
			compatible = "atmel,24c01";
			reg = <0x57 0x0 0x10>;
			pagesize = <0x8>;
		};
	};
```

## Documentation/devicetree/bindings/ipmi/aspeed,ast2400-ibt-bmc.txt
```
* Aspeed BT (Block Transfer) IPMI interface

The Aspeed SOCs (AST2400 and AST2500) are commonly used as BMCs
(BaseBoard Management Controllers) and the BT interface can be used to
perform in-band IPMI communication with their host.

Required properties:

- compatible : should be one of
	"aspeed,ast2400-ibt-bmc"
	"aspeed,ast2500-ibt-bmc"
- reg: physical address and size of the registers
- clocks: contains a phandle to the syscon node describing the clocks.
	  There should then be one cell representing the clock to use.

Optional properties:

- interrupts: interrupt generated by the BT interface. without an
  interrupt, the driver will operate in poll mode.

Example:

	ibt@1e789140 {
		compatible = "aspeed,ast2400-ibt-bmc";
		reg = <0x1e789140 0x18>;
		interrupts = <8>;
		clocks = <&syscon ASPEED_CLK_GATE_LCLK>;
	};
```

## Documentation/devicetree/bindings/jtag/aspeed-jtag.yaml
```yaml
# SPDX-License-Identifier: (GPL-2.0-only OR BSD-2-Clause)
%YAML 1.2
---
$id: http://devicetree.org/schemas/jtag/aspeed-jtag.yaml#
$schema: http://devicetree.org/meta-schemas/core.yaml#

title: Aspeed JTAG driver for ast2400, ast2500 and ast2600 SoC

description:
  Driver adds support of Aspeed 24/25/2600 series SOC JTAG master controller.
  Driver implements the following jtag ops
    freq_get
    freq_set
    status_get
    status_set
    xfer
    mode_set
    bitbang
    enable
    disable

  It has been tested on Mellanox system with BMC equipped with
  Aspeed 2520 SoC for programming CPLD devices.

  It has also been tested on Intel system using Aspeed 25xx SoC
  for JTAG communication.

  Tested on Intel system using Aspeed 26xx SoC for JTAG communication.

maintainers:
  - Oleksandr Shamray <oleksandrs@mellanox.com>
  - Jiri Pirko <jiri@mellanox.com>
  - Ernesto Corona<ernesto.corona@intel.com>

properties:
  compatible:
    oneOf:
      - items:
          - enum:
              - aspeed,ast2400-jtag
              - aspeed,ast2500-jtag
              - aspeed,ast2600-jtag


  reg:
    items:
      - description: JTAG Master controller register range

  interrupts:
    maxItems: 1

  clocks:
    maxItems: 1

required:
  - compatible
  - reg
  - interrupts
  - clocks

examples:
  - |
    #include <dt-bindings/clock/aspeed-clock.h>
    #include <dt-bindings/interrupt-controller/irq.h>

      jtag: jtag@1e6e4000 {
          compatible = "aspeed,ast2500-jtag";
          reg = <0x1e6e4000 0x1c>;
          clocks = <&syscon ASPEED_CLK_APB>;
          resets = <&syscon ASPEED_RESET_JTAG_MASTER>;
          interrupts = <43>;
      };
  - |
    #include <dt-bindings/clock/aspeed-clock.h>
    #include <dt-bindings/interrupt-controller/irq.h>

      jtag1: jtag@1e6e4100 {
          compatible = "aspeed,ast2600-jtag";
          reg = <0x1e6e4100 0x40>;
          clocks = <&syscon ASPEED_CLK_APB1>;
          resets = <&syscon ASPEED_RESET_JTAG_MASTER2>;
          interrupts = <GIC_SPI 53 IRQ_TYPE_LEVEL_HIGH>;
      };

...
```

## Documentation/devicetree/bindings/soc/aspeed/aspeed-lpc-sio.txt
```
* Aspeed LPC SIO driver.

Required properties:
- compatible : Should be one of:
	"aspeed,ast2400-lpc-sio"
	"aspeed,ast2500-lpc-sio"
- reg : Should contain lpc-sio registers location and length
- clocks: contains a phandle to the syscon node describing the clocks.
	  There should then be one cell representing the clock to use.

Example:
lpc_sio: lpc-sio@100 {
	compatible = "aspeed,ast2500-lpc-sio";
	reg = <0x100 0x20>;
        clocks = <&syscon ASPEED_CLK_GATE_LCLK>;
	status = "disabled";
};
```

## Documentation/devicetree/bindings/soc/aspeed/aspeed-vga-sharedmem.txt
```
* Aspeed VGA shared memory driver

Aspeed VGA shared memory driver allow user to read data from AST2500
VGA memory. This driver is required by ManagedDataRegionlV2
specification. In the spec, BIOS will transfer whole SMBIOS table to
VGA memroy and BMC get the table from VGA memory. 0penBMC project do
not allow to use /dev/mem for security concerns. To get the data in
VGA shared memory in user space, implement this driver only allowed
user to mmap limited memory area.

Required properties:
- compatible: "aspeed,ast2500-vga-sharedmem"
	- aspeed,ast2500-vga-sharedmem: Aspeed AST2500 family
- reg: Should contain VGA shared memory start address and length

Example:
vga-shared-memory {
	compatible = "aspeed,ast2500-vga-sharedmem";
	reg = <0x9ff00000 0x100000>;
};
```

## drivers/i3c/master/Kconfig
```kconfig
# SPDX-License-Identifier: GPL-2.0-only
config CDNS_I3C_MASTER
	tristate "Cadence I3C master driver"
	depends on I3C
	depends on HAS_IOMEM
	depends on !(ALPHA || PARISC)
	help
	  Enable this driver if you want to support Cadence I3C master block.

config DW_I3C_MASTER
	tristate "Synospsys DesignWare I3C master driver"
	depends on I3C
	depends on HAS_IOMEM
	depends on !(ALPHA || PARISC)
	# ALPHA and PARISC needs {read,write}sl()
	help
	  Support for Synopsys DesignWare MIPI I3C Controller.

	  For details please see
	  https://www.synopsys.com/dw/ipdir.php?ds=mipi_i3c

	  This driver can also be built as a module.  If so, the module
	  will be called dw-i3c-master.

config ASPEED_I3C_MASTER
	tristate "Aspeed I3C master driver"
	depends on I3C
	depends on MACH_ASPEED_G6
	select DW_I3C_MASTER
	help
	  Aspeed I3C master controller is a Synopsys DesignWare I3C controller
	  plus additional global control.
```

## drivers/soc/aspeed/Kconfig
```kconfig
# SPDX-License-Identifier: GPL-2.0-only
menu "Aspeed SoC drivers"

config SOC_ASPEED
	def_bool y
	depends on ARCH_ASPEED || COMPILE_TEST

config ASPEED_BMC_MISC
	bool "Miscellaneous ASPEED BMC interfaces"
	depends on ARCH_ASPEED || COMPILE_TEST
	default ARCH_ASPEED
	help
	  Say yes to expose VGA and LPC scratch registers, and other
	  miscellaneous control interfaces specific to the ASPEED BMC SoCs

config ASPEED_ESPI_SLAVE
	depends on ARCH_ASPEED || COMPILE_TEST
	depends on REGMAP_MMIO
	tristate "Aspeed ast2500 eSPI slave device driver"
	help
	  Control Aspeed ast2500 eSPI slave controller to handle event
	  which needs the firmware's processing.

config ASPEED_LPC_CTRL
	depends on SOC_ASPEED && REGMAP && MFD_SYSCON
	tristate "Aspeed ast2400/2500 HOST LPC to BMC bridge control"
	help
	  Control Aspeed ast2400/2500 HOST LPC to BMC mappings through
	  ioctl()s, the driver also provides a read/write interface to a BMC ram
	  region where the host LPC read/write region can be buffered.

config ASPEED_LPC_MBOX
	tristate "Aspeed LPC Mailbox Controller"
	depends on SOC_ASPEED && REGMAP && MFD_SYSCON
	---help---
	  Expose the ASPEED LPC MBOX registers found on Aspeed SOCs (AST2400
	  and AST2500) to userspace.

config ASPEED_LPC_SIO
	tristate "Aspeed ast2400/2500 HOST LPC SIO support"
	depends on SOC_ASPEED && REGMAP && MFD_SYSCON
	help
	  Provides a driver to control the LPC SIO interface on ASPEED platform
	  through ioctl()s.

config ASPEED_LPC_SNOOP
	tristate "Aspeed ast2500 HOST LPC snoop support"
	depends on SOC_ASPEED && REGMAP && MFD_SYSCON
	help
	  Provides a driver to control the LPC snoop interface which
	  allows the BMC to listen on and save the data written by
	  the host to an arbitrary LPC I/O port.

config ASPEED_MCTP
	tristate "Aspeed ast2600 MCTP Controller support"
	depends on SOC_ASPEED && REGMAP && MFD_SYSCON
	help
	  Enable support for ast2600 MCTP Controller.
	  The MCTP controller allows the BMC to communicate with devices on
	  the host PCIe network.

config ASPEED_P2A_CTRL
	depends on SOC_ASPEED && REGMAP && MFD_SYSCON
	tristate "Aspeed ast2400/2500 HOST P2A VGA MMIO to BMC bridge control"
	help
	  Control Aspeed ast2400/2500 HOST P2A VGA MMIO to BMC mappings through
	  ioctl()s, the driver also provides an interface for userspace mappings to
	  a pre-defined region.

config ASPEED_XDMA
	tristate "Aspeed XDMA Engine Driver"
	depends on SOC_ASPEED && REGMAP && MFD_SYSCON && HAS_DMA
	help
	  Enable support for the Aspeed XDMA Engine found on the Aspeed AST2XXX
	  SOCs. The XDMA engine can perform automatic PCI DMA operations
	  between the AST2XXX (acting as a BMC) and a host processor.

config ASPEED_VGA_SHAREDMEM
	tristate "Aspeed VGA Shared memory"
	depends on SOC_ASPEED
	help
	  To access VGA shared memory on Aspeed BMC, enable this option.
	  This driver used by ManagedDataRegionlV2 specification. In the
	  specification, BIOS will transfer whole SMBIOS table to VGA memory,
	  and BMC can get the table from VGA memory through this driver.

endmenu
```
